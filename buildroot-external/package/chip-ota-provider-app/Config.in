## buildroot-external/package/chip-ota-provider-app/Config.in
```kconfig
config BR2_PACKAGE_CHIP_OTA_PROVIDER_APP
    bool "chip-ota-provider-app"
    help
      This package downloads the chip-ota-provider-app and installs it
      to /usr/local/bin/chip-ota-provider-app.
```

## buildroot-external/package/tcpserver/Config.in
```kconfig
config BR2_PACKAGE_TCPSERVER
    bool "tcp server process tool"
    help
        tcp server process tool.
```

## buildroot-external/package/wifi-load/Config.in
```kconfig
config BR2_PACKAGE_WIFI_LOAD
    bool "wifi load"
    help
        multi wifi load driver
```
